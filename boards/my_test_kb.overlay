/ {
    chosen {
        zmk,kscan = &kscan0;
    };
};

&kscan0 {
    compatible = "zmk,kscan-matrix";
    row-gpios = <&gpio0 6 GPIO_ACTIVE_HIGH>,
                <&gpio0 7 GPIO_ACTIVE_HIGH>;
    col-gpios = <&gpio0 8 GPIO_ACTIVE_HIGH>,
                <&gpio0 9 GPIO_ACTIVE_HIGH>;
};
